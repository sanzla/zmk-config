/*
 * Copyright (c) 2020 The ZMK Contributors
 *
 * SPDX-License-Identifier: MIT
 */

#include "ferris_oled.dtsi"

nice_view_spi: &spi0 {
	compatible = "nordic,nrf-spim";
	sck-pin = <28>;
	mosi-pin = <27>;
	cs-gpios = <&pro_micro 29 GPIO_ACTIVE_HIGH>;
};