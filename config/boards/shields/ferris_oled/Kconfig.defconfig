## config/boards/shields/ferris_oled/Kconfig.defconfig
```kconfig
# Copyright (c) 2020 The ZMK Contributors
# SPDX-License-Identifier: MIT

if SHIELD_FERRIS_OLED_LEFT

config ZMK_KEYBOARD_NAME
	default "Ferris OLED"

config ZMK_SPLIT_ROLE_CENTRAL
	default y

endif

if SHIELD_FERRIS_OLED_LEFT || SHIELD_FERRIS_OLED_RIGHT

config ZMK_SPLIT
	default y

endif

if ZMK_DISPLAY

config I2C
	default y

config SSD1306
	default y

config SSD1306_REVERSE_MODE
	default y

endif # ZMK_DISPLAY
```

## config/boards/shields/ferris_oled/Kconfig.shield
```kconfig
# Copyright (c) 2020 The ZMK Contributors
# SPDX-License-Identifier: MIT

config SHIELD_FERRIS_OLED_LEFT
	def_bool $(shields_list_contains,ferris_oled_left)

config SHIELD_FERRIS_OLED_RIGHT
	def_bool $(shields_list_contains,ferris_oled_right)
```
